## base_external/Config.in
```kconfig
config BR2_PACKAGE_AESD_ASSIGNMENTS
	bool "aesd-assignments"
	help
	  Includes the writer executable, finder.sh and tester.sh in the kernel image.
	  Used to understand buildroot external trees and package builds.

config BR2_PACKAGE_LDD
	bool "ldd"
	help
	  Installs the misc-modules and scull components to the root filesystem
```

## base_external/package/ldd/Config.in
```kconfig
config BR2_PACKAGE_LDD
	bool "ldd"
	help
	  Installs the misc-modules and scull components to the root filesystem
```
